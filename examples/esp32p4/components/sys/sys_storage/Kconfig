## examples/esp32p4/components/sys/sys_storage/Kconfig
```kconfig
menu "Sys Storage"

config SYS_STORAGE_FONT_PATH
    string "Default CJK font path on SD card"
    default "/sdcard/fonts/NotoSansSC-VariableFont_wght.ttf"
    help
        POSIX path to a TrueType/OpenType CJK font file on the SD card.
        The file must be accessible after SD card mount.
        Used by sys_storage_font_get_default().

config SYS_STORAGE_FONT_SIZE
    int "Default CJK font size (px)"
    default 18
    range 8 64
    help
        Font size in pixels for the default CJK font.
        Uses FreeType BITMAP render mode for best performance on P4.

endmenu
```

## examples/esp32p4/main/Kconfig.projbuild
```kconfig
menu "Embedded Live2D"
config L2D_EXAMPLE_LIGHT
    bool "Run the 13-axis light.live hardware test example"
    default n
    help
        Runs a separate light model correctness and sustained FPS/CPU suite.
        Leaves the esp.live baseline selectable by disabling this option.

config L2D_LIGHT_FROM_SD
    bool "Read light.live from /sdcard/light.live instead of firmware flash"
    depends on L2D_EXAMPLE_LIGHT
    default n

config L2D_LIGHT_PHASE_SECONDS
    int "Measured seconds per light workload (plus 2 s warmup)"
    depends on L2D_EXAMPLE_LIGHT
    range 10 120
    default 30

config L2D_PROFILE_TIMING
    bool "Record per-frame pipeline timings into a fixed ring"
    default y

config L2D_PROFILE_STAGE
    int "Benchmark scenario set: 0=baseline v2, 1=RT30/vertex, 2=PPA A/B"
    range 0 2
    depends on L2D_PROFILE_TIMING
    default 0

config L2D_PROFILE_CORRECTNESS
    bool "Run fixed-pose ARGB8888 and RGB565 CRC checks instead of timings"
    default n
    help
        This independent mode renders fixed poses and computes CRC after each frame.
        It must not be used for timing benchmarks.

config L2D_RASTER_WORKERS
    bool "Rasterize disjoint rows on both P4 CPU cores"
    depends on !L2D_PROFILE_DETAIL
    default n
    help
        Preallocates an ordered triangle list per instance. Workers preserve
        painter order within each row and join before PPA conversion.

config L2D_RENDER_RGB565_BANDS
    bool "Compose exact BGRA in SRAM bands then write RGB565"
    depends on L2D_RASTER_WORKERS
    default n
    help
        Uses bounded SRAM per core. Each band blends at full BGRA precision,
        then writes terminal RGB565. The BGRA API supports alpha composition.

config L2D_RASTER_SCRATCH_BYTES
    int "Internal SRAM scratch bytes per raster worker"
    depends on L2D_RASTER_WORKERS
    range 32768 98304
    default 65536 if L2D_RENDER_RGB565_BANDS
    default 32768
    help
        Allocated at renderer initialization when a scratch path is enabled.
        Larger bands reduce traversal and consume more internal SRAM.

config L2D_RASTER_SCRATCH
    bool "Experimental SRAM band raster scratch"
    depends on L2D_RASTER_WORKERS
    default n
    help
        Retains the measured band-copy experiment; copying a full BGRA canvas
        both ways can be slower than direct PSRAM rendering. Disabled by default.

config L2D_CLEAR_OVERLAP
    bool "Evaluate pose while PPA clears the framebuffer"
    depends on !L2D_CLEAR_CPU && !L2D_CLEAR_PIE
    default n
    help
        Uses a PPA completion semaphore. Pose is evaluated once while the
        hardware fills; raster waits for completion and cache invalidation.

config L2D_CLEAR_PIE
    bool "Use exact ESP32-P4 PIE SIMD clear"
    default n

config L2D_CONVERT_BITSCRAMBLER
    bool "Exact BGRA8888 to RGB565 using BitScrambler DMA loopback"
    default n
    help
        Reserves GPSPI2 GDMA for memory-to-memory bit packing. Requires no
        other GPSPI2 DMA client. Preallocates links at renderer initialization.

config L2D_CONVERT_PIE
    bool "Use exact ESP32-P4 PIE SIMD RGB565 conversion"
    default n

config L2D_CLEAR_CPU
    bool "Use CPU memset for ARGB clear in normal rendering"
    default n
    help
        Phase 2 can override this setting temporarily to measure all four
        backend combinations. The setting controls the normal runtime default.

config L2D_CONVERT_CPU
    bool "Use CPU ARGB8888 to RGB565 conversion in normal rendering"
    default n
    help
        Phase 2 can override this setting temporarily to measure all four
        backend combinations. The setting controls the normal runtime default.

config L2D_PROFILE_FINE
    bool "Instrument hierarchy and vertex subphases (diagnostic only)"
    depends on L2D_PROFILE_TIMING
    default n
    help
        Adds timer calls inside the vertex loop. Its timings are diagnostic
        workload attribution, not formal benchmark results.

config L2D_PROFILE_VISUAL
    bool "Count visual-transform calls and reuse (diagnostic only)"
    default n
    help
        Counts visual-transform, rotation, and trigonometric calls and
        records parent-chain reuse. This build is not a timing benchmark.
        Leave it off for formal Stage 0/1/2 measurements.

config L2D_PROFILE_DETAIL
    bool "Collect raster workload counters (separate diagnostic build)"
    default n
    help
        Adds per-fragment counters. These runs are not timing benchmarks.

config L2D_PROFILE_ROI_DIAG
    bool "Collect geometry ROI diagnostics without changing conversion"
    default n
    help
        Adds screen-space triangle bounds and previous/current union counters.
        This build is diagnostic only and is not a formal timing benchmark.

config L2D_SRM_ROI
    bool "Convert only previous/current Live2D geometry union with PPA SRM"
    default n
    help
        Keeps full ARGB clear, raster, cache synchronization, and panel submit.
        Only the blocking ARGB8888 to RGB565 PPA SRM block is reduced.

config L2D_PROFILE_OVERDRAW
    bool "Collect uint8 overdraw map"
    depends on L2D_PROFILE_DETAIL
    default n

endmenu
```

## firmware/esp32p4/live2d_rt30_baseline/main/Kconfig.projbuild
```kconfig
menu "Live2D profiling baseline"
config L2D_PROFILE_TIMING
    bool "Record per-frame pipeline timings into a fixed ring"
    default y

config L2D_PROFILE_STAGE
    int "Benchmark scenario set: 0=baseline v2, 1=RT30/vertex, 2=PPA A/B"
    range 0 2
    depends on L2D_PROFILE_TIMING
    default 0

config L2D_PROFILE_CORRECTNESS
    bool "Run fixed-pose ARGB8888 and RGB565 CRC checks instead of timings"
    default n
    help
        This independent mode renders fixed poses and computes CRC after each frame.
        It must not be used for timing benchmarks.

config L2D_CLEAR_CPU
    bool "Use CPU memset for ARGB clear in normal rendering"
    default n
    help
        Phase 2 can override this setting temporarily to measure all four
        backend combinations. The setting controls the normal runtime default.

config L2D_CONVERT_CPU
    bool "Use CPU ARGB8888 to RGB565 conversion in normal rendering"
    default n
    help
        Phase 2 can override this setting temporarily to measure all four
        backend combinations. The setting controls the normal runtime default.

config L2D_PROFILE_FINE
    bool "Instrument hierarchy and vertex subphases (diagnostic only)"
    depends on L2D_PROFILE_TIMING
    default n
    help
        Adds timer calls inside the vertex loop. Its timings are diagnostic
        workload attribution, not formal benchmark results.

config L2D_PROFILE_VISUAL
    bool "Count visual-transform calls and reuse (diagnostic only)"
    default n
    help
        Counts visual-transform, rotation, and trigonometric calls and
        records parent-chain reuse. This build is not a timing benchmark.
        Leave it off for formal Stage 0/1/2 measurements.

config L2D_PROFILE_DETAIL
    bool "Collect raster workload counters (separate diagnostic build)"
    default n
    help
        Adds per-fragment counters. These runs are not timing benchmarks.

config L2D_PROFILE_OVERDRAW
    bool "Collect uint8 overdraw map"
    depends on L2D_PROFILE_DETAIL
    default n

endmenu
```
